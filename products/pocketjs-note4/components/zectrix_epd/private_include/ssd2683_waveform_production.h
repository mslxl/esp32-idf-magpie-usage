#ifndef SSD2683_WAVEFORM_PRODUCTION_H_
#define SSD2683_WAVEFORM_PRODUCTION_H_

#include <array>
#include <cstddef>
#include <cstdint>

namespace ssd2683_waveform {

// Generated from the pinned NOTE4 source revision by extract_waveform.py.
// Source revision: ca285c98ed0641f86780edb1f5ec77b0335fe649
// The experimental generator remains available for provenance, but firmware
// includes this validated payload so its source-only assertions do not run.
constexpr size_t kWaveformSize = 535;
constexpr size_t kVendorGray16RenderPassCount = 5;
constexpr size_t kVendorGray16LevelCount = 16;
constexpr size_t kVendorGray16RenderWaveformHashCount = 5;

constexpr std::array<std::array<uint8_t, kWaveformSize>,
                     kVendorGray16RenderPassCount>
kVendorGray16RenderWaveforms = {{
    {{
    0x00, 0x14, 0x78, 0x78, 0x14, 0x85, 0x08, 0xEF, 0xEF, 0xEF, 0xAF, 0x2F, 0xFF, 0xEF, 0xAF, 0xFF,
    0xEF, 0xEF, 0xEF, 0xEF, 0xEF, 0x3F, 0x7F, 0xFF, 0xEF, 0x7F, 0x3F, 0xFF, 0xEF, 0xEF, 0xEF, 0xEF,
    0xFF, 0xEF, 0xFF, 0xEF, 0xEF, 0x7D, 0x7D, 0xEF, 0xEF, 0xEF, 0xEF, 0xFF, 0xEF, 0xFF, 0xEF, 0xEF,
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    0xFF, 0xFF, 0xFF, 0xFF, 0xFF, 0xFF, 0xFF,
    }},
    {{
    0x00, 0x14, 0x78, 0x78, 0x14, 0x85, 0x08, 0xEF, 0xEF, 0xEF, 0xAF, 0x2F, 0xFF, 0xEF, 0xAF, 0xFF,
    0xEF, 0xEF, 0xEF, 0xEF, 0xEF, 0x3F, 0x7F, 0xFF, 0xEF, 0x7F, 0x3F, 0xFF, 0xEF, 0xEF, 0xEF, 0xEF,
    0xFF, 0xEF, 0xFF, 0xEF, 0xEF, 0x7D, 0x7D, 0xEF, 0xEF, 0xEF, 0xEF, 0xFF, 0xEF, 0xFF, 0xEF, 0xEF,
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    0xFF, 0xFF, 0xFF, 0xFF, 0xFF, 0xFF, 0xFF,
    }},
    {{
    0x00, 0x14, 0x78, 0x78, 0x14, 0x85, 0x08, 0xEF, 0xEF, 0xEF, 0xAF, 0x2F, 0xFF, 0xEF, 0xAF, 0xFF,
    0xEF, 0xEF, 0xEF, 0xEF, 0xEF, 0x3F, 0x7F, 0xFF, 0xEF, 0x7F, 0x3F, 0xFF, 0xEF, 0xEF, 0xEF, 0xEF,
    0xFF, 0xEF, 0xFF, 0xEF, 0xEF, 0x7D, 0x7D, 0xEF, 0xEF, 0xEF, 0xEF, 0xFF, 0xEF, 0xFF, 0xEF, 0xEF,
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    0xFF, 0xFF, 0xFF, 0xFF, 0xFF, 0xFF, 0xFF,
    }},
    {{
    0x00, 0x14, 0x78, 0x78, 0x14, 0x85, 0x08, 0xEF, 0xEF, 0xEF, 0xAF, 0x2F, 0xFF, 0xEF, 0xAF, 0xFF,
    0xEF, 0xEF, 0xEF, 0xEF, 0xEF, 0x3F, 0x7F, 0xFF, 0xEF, 0x7F, 0x3F, 0xFF, 0xEF, 0xEF, 0xEF, 0xEF,
    0xFF, 0xEF, 0xFF, 0xEF, 0xEF, 0x7D, 0x7D, 0xEF, 0xEF, 0xEF, 0xEF, 0xFF, 0xEF, 0xFF, 0xEF, 0xEF,
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    0xFF, 0xFF, 0xFF, 0xFF, 0xFF, 0xFF, 0xFF,
    }},
    {{
    0x00, 0x14, 0x78, 0x78, 0x14, 0x85, 0x08, 0xEF, 0xEF, 0xEF, 0xAF, 0x2F, 0xFF, 0xEF, 0xAF, 0xFF,
    0xEF, 0xEF, 0xEF, 0xEF, 0xEF, 0x3F, 0x7F, 0xFF, 0xEF, 0x7F, 0x3F, 0xFF, 0xEF, 0xEF, 0xEF, 0xEF,
    0xFF, 0xEF, 0xFF, 0xEF, 0xEF, 0x7D, 0x7D, 0xEF, 0xEF, 0xEF, 0xEF, 0xFF, 0xEF, 0xFF, 0xEF, 0xEF,
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    0xFF, 0xFF, 0xFF, 0xFF, 0xFF, 0xFF, 0xFF,
    }},
}};

constexpr std::array<uint32_t, kVendorGray16RenderWaveformHashCount>
    kVendorGray16RenderWaveformHashes = {{
        0x7ABDAE2Du, 0x87F8AEC2u, 0x51B56FB5u, 0x1D5936AFu, 0x3078F509u
    }};

constexpr size_t VendorGray16RenderPassOfLevel(size_t level) {
    return level < 15 ? level / 3 : kVendorGray16RenderPassCount;
}

constexpr uint8_t VendorGray16RenderCodeOfLevel(size_t level) {
    return level < 15 ? static_cast<uint8_t>(level % 3 + 1) : 0;
}

constexpr uint32_t Fnv1a32(const std::array<uint8_t, kWaveformSize>& waveform) {
    uint32_t result = 0x811C9DC5u;
    for (uint8_t value : waveform) {
        result ^= value;
        result *= 0x01000193u;
    }
    return result;
}

constexpr bool ValidateGray16RenderPayload() {
    for (size_t pass = 0; pass < kVendorGray16RenderPassCount; ++pass) {
        if (Fnv1a32(kVendorGray16RenderWaveforms[pass]) !=
            kVendorGray16RenderWaveformHashes[pass]) {
            return false;
        }
        for (size_t record = 0; record < 8; ++record) {
            const size_t offset = 7 + 88 + record * 11;
            if (kVendorGray16RenderWaveforms[pass][offset + 1] != 0xFF ||
                kVendorGray16RenderWaveforms[pass][offset + 2] != 0xFF) {
                return false;
            }
        }
    }
    return VendorGray16RenderPassOfLevel(15) == kVendorGray16RenderPassCount &&
           VendorGray16RenderCodeOfLevel(15) == 0;
}

static_assert(kWaveformSize == 535, "SSD2683 waveform size changed");
static_assert(kVendorGray16RenderPassCount == 5,
              "SSD2683 gray16 render pass count changed");
static_assert(kVendorGray16LevelCount == 16,
              "SSD2683 gray16 level count changed");
static_assert(ValidateGray16RenderPayload(),
              "SSD2683 production gray16 payload failed validation");

}  // namespace ssd2683_waveform

#endif  // SSD2683_WAVEFORM_PRODUCTION_H_
